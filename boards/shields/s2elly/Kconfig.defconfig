## boards/shields/s2elly/Kconfig.defconfig
```kconfig
if SHIELD_S2ELLY_LEFT

config ZMK_KEYBOARD_NAME
    default "S2elly"

config ZMK_SPLIT_ROLE_CENTRAL
    default y

endif

if SHIELD_S2ELLY_LEFT || SHIELD_S2ELLY_RIGHT

config ZMK_SPLIT
    default y

endif
```

## boards/shields/s2elly/Kconfig.shield
```kconfig
config SHIELD_S2ELLY_LEFT
    def_bool $(shields_list_contains,s2elly_left)

config SHIELD_S2ELLY_RIGHT
    def_bool $(shields_list_contains,s2elly_right)
```
